#include "ssd1306.h"

#include "system/delay.h"
#include <string.h>

#define SSD1306_PAGE_NUM                8
#define SSD1306_PAGE_WIDTH              128
#define SSD1306_CHAR_WIDTH              8
#define SSD1306_CHAR_HEIGHT_PAGE        2
#define SSD1306_LINE_NUM                4
#define SSD1306_COLUMN_NUM              16

// oled 字模库，宽 8 像素，高 16 像素
static const uint8_t oled_font_8x16[][16] =
{
    0x00, 0x00, 0x00, 0x00, 0x00, 0x00, 0x00, 0x00,
    0x00, 0x00, 0x00, 0x00, 0x00, 0x00, 0x00, 0x00,		//   0

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    0x00, 0x00, 0x00, 0x00, 0x00, 0x00, 0x00, 0x00,		// ~ 94
};

/**
 * @brief 构造函数
 *
 * @param spi_bus_num SPI 总线编号
 * @param cs_port cs 引脚端口
 * @param cs_pin cs 引脚编号
 * @param res_port 复位引脚端口
 * @param res_pin 复位引脚编号
 * @param dc_port 数据命令引脚端口
 * @param dc_pin 数据命令引脚编号
 */
ssd1306::ssd1306(uint8_t spi_bus_num,
                 GPIO_TypeDef *cs_port, uint16_t cs_pin,
                 GPIO_TypeDef *res_port, uint16_t res_pin,
                 GPIO_TypeDef *dc_port, uint16_t dc_pin)
    : spi(spi_bus_num),
      cs_port(cs_port),
      cs_pin(cs_pin),
      res_port(res_port),
      res_pin(res_pin),
      dc_port(dc_port),
      dc_pin(dc_pin)
{
    memset(fb, 0, sizeof(fb));
    memset(dirty, 1, sizeof(dirty));
}

/**
 * @brief 初始化 ssd1306
 */
void ssd1306::init()
{
    if(is_init){return;}
    is_init = true;

    spi.init();
    spi.cs_high(cs_port, cs_pin);
    HAL_GPIO_WritePin(dc_port, dc_pin, GPIO_PIN_SET);

    HAL_GPIO_WritePin(res_port, res_pin, GPIO_PIN_RESET);
    delay::ms(200);
    HAL_GPIO_WritePin(res_port, res_pin, GPIO_PIN_SET);

    write_command(0xAE);    // 关闭显示

    write_command(0xD5);    // 设置显示时钟分频比/振荡器频率
    write_command(0x80);

    write_command(0xA8);    // 设置多路复用率
    write_command(0x3F);

    write_command(0xD3);    // 设置显示偏移
    write_command(0x00);

    write_command(0x40);    // 设置显示开始行

    write_command(0xA1);    // 设置左右方向，0xA1 正常，0xA0 左右反置

    write_command(0xC8);    // 设置上下方向，0xC8 正常，0xC0 上下反置

    write_command(0xDA);    // 设置 COM 引脚硬件配置
    write_command(0x12);

    write_command(0x81);    // 设置对比度控制
    write_command(0xCF);

    write_command(0xD9);    // 设置预充电周期
    write_command(0xF1);

    write_command(0xDB);    // 设置 VCOMH 取消选择级别
    write_command(0x30);

    write_command(0xA4);    // 设置整个显示打开/关闭

    write_command(0xA6);    // 设置正常/倒转显示

    write_command(0x8D);    // 设置充电泵
    write_command(0x14);

    write_command(0xAF);    // 开启显示

    clear();
    flush();
}

/**
 * @brief 清空帧缓冲区
 */
void ssd1306::clear()
{
    memset(fb, 0x00, sizeof(fb));
    memset(dirty, 1, sizeof(dirty));
}

/**
 * @brief 刷新显示
 */
void ssd1306::flush()
{
    uint8_t cmds[3];

    for(uint8_t page = 0; page < SSD1306_PAGE_NUM; page++)
    {
        if(!dirty[page]){continue;}

        cmds[0] = 0xB0 | page;
        cmds[1] = 0x00;
        cmds[2] = 0x10;

        write_commands(cmds, sizeof(cmds));
        write_data(fb[page], SSD1306_PAGE_WIDTH);

        dirty[page] = 0;
    }
}

/**
 * @brief 开启显示
 */
void ssd1306::display_on()
{
    const uint8_t cmds[3] = {0x8D, 0x14, 0xAF};
    write_commands(cmds, sizeof(cmds));
}

/**
 * @brief 关闭显示
 */
void ssd1306::display_off()
{
    const uint8_t cmds[3] = {0x8D, 0x10, 0xAE};
    write_commands(cmds, sizeof(cmds));
}

/**
 * @brief 显示字符串
 *
 * @param line 起始行位置，范围 1~4
 * @param column 起始列位置，范围 1~16
 * @param string 要显示的字符串
 */
void ssd1306::show_string(uint8_t line, uint8_t column, const char *string)
{
    if(!string){return;}

    for(uint8_t i = 0; string[i] != '\0'; i++)
    {
        show_char(line, column + i, string[i]);
    }
}

/**
 * @brief 显示十进制无符号数
 *
 * @param line 起始行位置
 * @param column 起始列位置
 * @param number 要显示的数字
 * @param length 显示长度
 */
void ssd1306::show_num(uint8_t line, uint8_t column, uint32_t number, uint8_t length)
{
    for(uint8_t i = 0; i < length; i++)
    {
        show_char(line, column + i, number / pow_uint(10, length - i - 1) % 10 + '0');
    }
}

/**
 * @brief 显示十进制有符号数
 *
 * @param line 起始行位置
 * @param column 起始列位置
 * @param number 要显示的数字
 * @param length 显示长度
 */
void ssd1306::show_signed_num(uint8_t line, uint8_t column, int32_t number, uint8_t length)
{
    uint32_t abs_number;
    if(number >= 0)
    {
        show_char(line, column, '+');
        abs_number = (uint32_t)number;
    }
    else
    {
        show_char(line, column, '-');
        abs_number = (uint32_t)(-(int64_t)number);
    }

    for(uint8_t i = 0; i < length; i++)
    {
        show_char(line, column + i + 1, abs_number / pow_uint(10, length - i - 1) % 10 + '0');
    }
}

/**
 * @brief 显示十六进制无符号数
 *
 * @param line 起始行位置
 * @param column 起始列位置
 * @param number 要显示的数字
 * @param length 显示长度
 */
void ssd1306::show_hex_num(uint8_t line, uint8_t column, uint32_t number, uint8_t length)
{
    for(uint8_t i = 0; i < length; i++)
    {
        uint8_t single_num = number / pow_uint(16, length - i - 1) % 16;
        if(single_num < 10)
        {
            show_char(line, column + i, single_num + '0');
        }
        else
        {
            show_char(line, column + i, single_num - 10 + 'A');
        }
    }
}

/**
 * @brief 显示二进制无符号数
 *
 * @param line 起始行位置
 * @param column 起始列位置
 * @param number 要显示的数字
 * @param length 显示长度
 */
void ssd1306::show_bin_num(uint8_t line, uint8_t column, uint32_t number, uint8_t length)
{
    for(uint8_t i = 0; i < length; i++)
    {
        show_char(line, column + i, number / pow_uint(2, length - i - 1) % 2 + '0');
    }
}

/**
 * @brief 写入单个命令
 *
 * @param command 命令值
 */
void ssd1306::write_command(uint8_t command)
{
    HAL_GPIO_WritePin(dc_port, dc_pin, GPIO_PIN_RESET);
    spi.cs_low(cs_port, cs_pin);
    spi.tx(&command, 1);
    spi.cs_high(cs_port, cs_pin);
    HAL_GPIO_WritePin(dc_port, dc_pin, GPIO_PIN_SET);
}

/**
 * @brief 连续写入命令
 *
 * @param commands 命令缓冲区
 * @param len 命令长度
 */
void ssd1306::write_commands(const uint8_t *commands, uint8_t len)
{
    if(!commands || !len){return;}

    HAL_GPIO_WritePin(dc_port, dc_pin, GPIO_PIN_RESET);
    spi.cs_low(cs_port, cs_pin);
    spi.tx(commands, len);
    spi.cs_high(cs_port, cs_pin);
    HAL_GPIO_WritePin(dc_port, dc_pin, GPIO_PIN_SET);
}

/**
 * @brief 连续写入数据
 *
 * @param data 数据缓冲区
 * @param len 数据长度
 */
void ssd1306::write_data(const uint8_t *data, uint8_t len)
{
    if(!data || !len){return;}

    HAL_GPIO_WritePin(dc_port, dc_pin, GPIO_PIN_SET);
    spi.cs_low(cs_port, cs_pin);
    spi.tx(data, len);
    spi.cs_high(cs_port, cs_pin);
}

/**
 * @brief 显示单个字符
 *
 * @param line 行位置，范围 1~4
 * @param column 列位置，范围 1~16
 * @param ascii_char ASCII 可见字符
 */
void ssd1306::show_char(uint8_t line, uint8_t column, char ascii_char)
{
    if(line < 1 || line > SSD1306_LINE_NUM){return;}
    if(column < 1 || column > SSD1306_COLUMN_NUM){return;}
    if(ascii_char < ' ' || ascii_char > '~'){return;}

    uint8_t page = (line - 1) * SSD1306_CHAR_HEIGHT_PAGE;
    uint8_t x = (column - 1) * SSD1306_CHAR_WIDTH;
    uint8_t idx = (uint8_t)(ascii_char - ' ');

    for(uint8_t i = 0; i < SSD1306_CHAR_WIDTH; i++)
    {
        fb[page][x + i] = oled_font_8x16[idx][i];
        fb[page + 1][x + i] = oled_font_8x16[idx][i + SSD1306_CHAR_WIDTH];
    }

    dirty[page] = 1;
    dirty[page + 1] = 1;
}

/**
 * @brief 整数次方
 *
 * @param x 底数
 * @param y 指数
 *
 * @return x 的 y 次方
 */
uint32_t ssd1306::pow_uint(uint32_t x, uint32_t y)
{
    uint32_t result = 1;
    while(y--)
    {
        result *= x;
    }
    return result;
}
